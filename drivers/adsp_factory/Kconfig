## drivers/adsp_factory/Kconfig
```kconfig
#
# factory sensor drivers configuration
#
config ADSP_SENSORS_CORE
         bool "sensors_core"

config ADSP_FACTORY
	tristate "MSM ADSP factory driver"
	default n
	help
	  Provides access to ADSP user space.

config BMI168_FACTORY
	tristate "factory test for adsp - bmi168"
	default n
	help
	  bmi168 file for factory test in adsp.

config K6DS3_FACTORY
	tristate "factory test for adsp - k6ds3"
	default n
	help
	  k6ds3 file for factory test in adsp.

config AK09911C_FACTORY
	tristate "factory test for adsp - ak09911c"
	default n
	help
	  ak09911c file for factory test in adsp.

config BMP280_FACTORY
	tristate "factory test for adsp - bmp280"
	default n
	help
	  bmp280 file for factory test in adsp.

config TMD490X_FACTORY
	tristate "factory test for adsp - tmd490x"
	default n
	help
	  tmd490x file for factory test in adsp.
```

## drivers/video/msm/mdss/samsung/Kconfig
```kconfig
config SAMSUNG_DEBUG_DISPLAY
    bool "Add Samsung Debugging code"
    default n

config FB_MSM_MDSS_SAMSUNG
	depends on FB_MSM_MDSS
	bool "mdss config for samsung product"
	default n
	---help---
	Mdss config signature for samsung product

#
#	PANEL UNIQUE FEATURE
#
config DUAL_PANEL
	depends on FB_MSM_MDSS_SAMSUNG
	bool "dual paneloperation"
	default n
	---help---
	dual panel operation support

config PARTIAL_UPDATE
	depends on FB_MSM_MDSS_SAMSUNG
	bool "partial update operation"
	default n
	---help---
	partial update operation support

config CABC_FUNCTION
	depends on FB_MSM_MDSS_SAMSUNG
	bool "DDI cabc operation"
	default n
	---help---
	DDI cabc operation support

#
#	HOW TO MAKE DEF-CONFIG NAME FOR PANEL
#
#	PANEL_DDI-model_PANEL-model_RESOLUTION
#	PANEL_S6E3FA2    _AMS510CV01_FHD
#	PANEL_S6E3FA2_AMS510CV01_FHD
#

config PANEL_S6E3HF4_AMB526JS01_WQHD
	depends on FB_MSM_MDSS_SAMSUNG
	bool "LSI S6E3HF4 LDI"
	default n
	---help---
	LSI S6E3HF4 LDI 1440_2560 HERO DSC

config PANEL_S6E3HA2_AMS509ES01_WQHD
	depends on FB_MSM_MDSS_SAMSUNG
	bool "LSI S6E3HA2 LDI"
	default n
	---help---
	LSI S6E3HF2 LDI 1440_2560 HERO

config PANEL_S6E3HA3_AMS567JA01_WQHD
	depends on FB_MSM_MDSS_SAMSUNG
	bool "LSI S6E3HA3 LDI"
	default n
	---help---
	LSI S6E3HA3 LDI 1440_2560 HERO DSC TEST
```
